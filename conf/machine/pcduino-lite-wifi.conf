## conf/machine/pcduino-lite-wifi.conf
```bitbake
#@TYPE: Machine
#@NAME: LinkSprite pcDuino Lite WiFi Board
#@DESCRIPTION: Machine configuration for LinkSprite pcDuino Lite WiFi Board, based on Allwinner A10 CPU
#http://www.linksprite.com

# There are also LCD possibilities
GUI_MACHINE_CLASS = "bigscreen"

require conf/machine/include/tune-cortexa8.inc
require conf/machine/include/sunxi.inc
require conf/machine/include/sunxi-mali.inc


UBOOT_MACHINE = "pcDuino_Lite_WiFi_config"
UBOOT_ENTRYPOINT = "0x40008000"
UBOOT_LOADADDRESS = "0x40008000"

SERIAL_CONSOLE = "115200 ttyS0"

MACHINE_FEATURES = "kernel26 screen apm usbgadget usbhost vfat alsa"
```
